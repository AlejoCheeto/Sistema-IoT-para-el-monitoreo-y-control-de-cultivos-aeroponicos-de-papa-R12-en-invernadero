/* Ruler 1         2         3         4         5         6         7        */
/******************************************************************************/
/*                                                                            */
/*   +----+ +----+                         dying_control                      */
/*   ++  ++ ++******                                                          */
/*    |  |   |**  **      This code is used for a IoT monitoring node         */
/*    |  |   | *  *       for an aeroponic potato module using a TTGO Lora32  */
/*    |  |   | *  *       board.This node measures pH and that data throught  */
/*    |******| *  *       LoRaWAN network to a gateway.The LoRaWAN            */
/*    |**  **| *  *       connection is is based on MCCI LoRAWAN LCIM library */                                             
/*    ++*  ** **  *                                                           */
/*     +**  ***  **                                                           */
/*      +**     **        DOCUMENTED BY: Alejandro Pachón Garzón              */                                            
/*        *******                        paalejandro@javeriana.edu.co         */
/*                                                                            */
/*                        IMPLEMENTED BY: Juan Esteban Rodríguez Hernández    */
/*                                        jesteban.rodriguez@javeriana.edu.co */
/*                                        Alejandro Pachón Garzón             */
/*                                        palejandro@javeriana.edu.co         */
/*                                                                            */
/*                        Bogota, D.C., Octubre 14th, 2024.                   */                               
/*          Copyright (C) Department de Electronics                           */
/*                        School of Engineering                               */
/*                        Pontificia Universidad Javeriana                    */
/*                        Bogota - Colombia - South America                   */
/*                                                                            */
/******************************************************************************/
 // Copyright (c) 2015 Thomas Telkamp and Matthijs Kooijman
 // Copyright (c) 2018 Terry Moore, MCCI

//************************************************************************************************************
// LIBRARIES ------------------------------------------------------------------------------
#include <lmic.h>
#include <hal/hal.h>
#include <SPI.h>
#include <string>

#include <Arduino.h>
#include <Wire.h>
#include "Adafruit_SHT31.h"
#include <Adafruit_GFX.h>
#include <Adafruit_SSD1306.h>

#include "esp_system.h"
#include "rom/ets_sys.h"

//************************************************************************************************************
// SENSORS FMS STATE DEFINITION ------------------------------------------------------------------------------
typedef enum
{
  INI,
  PH_READ,
  KTD_1,
  MEAN,
  SEND_DATA,
  KTD_2,
  KTD_3,
  DELAY,
  KTD_4
} control_states;
//************************************************************************************************************
// MACROS ----------------------------------------------------------------------------------------------------
  #define PH_PIN 36
  // SSD1306 OLEC SCREEN
  #define SCREEN_WIDTH   128 // OLED display width, in pixels
  #define SCREEN_HEIGHT  64 // OLED display height, in pixels 
  #define SCREEN_ADDRESS 0x3C 
  #define OLED_RESET    -1 // Reset 
  #define LOGO_HEIGHT   64
  #define LOGO_WIDTH    128
//************************************************************************************************************
// SDD1306 BITMAP LOGOS --------------------------------------------------------------------------------------
static const unsigned char PROGMEM logo_bmp[] =
{ 
  0b00000000, 0b11000000,
  0b00000001, 0b11000000,
  0b00000001, 0b11000000,
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  0b00000000, 0b00110000 };

static const unsigned char PROGMEM agrosavia_logo []  = 
{
	0xff, 0xff, 0xff, 0xff, 0xff, 0xff, 0xff, 0xff, 0xff, 0xff, 0xff, 0xff, 0xff, 0xff, 0xff, 0xff, 
	0xff, 0xff, 0xff, 0xff, 0xff, 0xff, 0xff, 0xff, 0xff, 0xff, 0xff, 0xff, 0xff, 0xff, 0xff, 0xff, 
	0xff, 0xff, 0xff, 0xff, 0xff, 0xff, 0xff, 0xff, 0xff, 0xff, 0xff, 0xff, 0xff, 0xff, 0xff, 0xff, 
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	0xff, 0xff, 0xff, 0xff, 0xff, 0xff, 0xff, 0xff, 0xff, 0xff, 0xff, 0xff, 0xff, 0xff, 0xff, 0xff};

static const unsigned char PROGMEM cea_logo [] = 
{
	0xff, 0xff, 0xff, 0xff, 0xff, 0xff, 0xff, 0xff, 0xff, 0xff, 0xff, 0xff, 0xff, 0xff, 0xff, 0xff, 
	0xff, 0xff, 0xff, 0xff, 0xff, 0xff, 0xff, 0xff, 0xff, 0xff, 0xff, 0xff, 0xff, 0xff, 0xff, 0xff, 
	0xff, 0xff, 0xff, 0xff, 0xff, 0xff, 0xff, 0xff, 0xff, 0xff, 0xff, 0xff, 0xff, 0xff, 0xff, 0xff, 
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	0xff, 0xff, 0xff, 0xff, 0xff, 0xff, 0xff, 0xff, 0xff, 0xff, 0xff, 0xff, 0xff, 0xff, 0xff, 0xff};
const unsigned char PROGMEM unconnected_icon []  = 
{
	0x00, 0x1f, 0xe0, 0x00, 0x00, 0x7f, 0xf8, 0x00, 0x01, 0xfb, 0x7e, 0x00, 0x03, 0xb3, 0x37, 0x18, 
	0x0e, 0x63, 0x19, 0xfc, 0x0e, 0x63, 0x19, 0xf8, 0x1f, 0xe3, 0x1f, 0xf0, 0x31, 0xff, 0xff, 0xf0, 
	0x30, 0xff, 0xff, 0xb0, 0x60, 0x83, 0x0f, 0x18, 0x61, 0x83, 0x1e, 0x18, 0xc1, 0x83, 0x7e, 0x0c, 
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	0x00, 0x7f, 0xf8, 0x00, 0x00, 0x1f, 0xe0, 0x00};

const unsigned char PROGMEM connected_icon [] = 
{ 
  0x00, 0x1f, 0xe0, 0x00, 0x00, 0xff, 0xfc, 0x00, 0x01, 0xfb, 0x7e, 0x00, 0x07, 0x33, 0x33, 0x80, 
	0x0e, 0x63, 0x19, 0xc0, 0x1e, 0x63, 0x19, 0xe0, 0x1f, 0xc3, 0x0f, 0xe0, 0x31, 0xff, 0xfe, 0x30, 
	0x60, 0xff, 0xfc, 0x18, 0x61, 0x83, 0x06, 0x18, 0x61, 0x83, 0x06, 0x18, 0xc1, 0x83, 0x06, 0x0c, 
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	0x00, 0xff, 0xfc, 0x00, 0x00, 0x1f, 0xe0, 0x00};

Adafruit_SSD1306 display(SCREEN_WIDTH, SCREEN_HEIGHT, &Wire, OLED_RESET);

//************************************************************************************************************
// LoRaWAN LMIC LIBRARY VARIABLES ----------------------------------------------------------------------------
// * Include comments from initial implementation
//
// For normal use, we require that you edit the sketch to replace FILLMEIN
// with values assigned by the TTN console. However, for regression tests,
// we want to be able to compile these scripts. The regression tests define
// COMPILE_REGRESSION_TEST, and in that case we define FILLMEIN to a non-
// working but innocuous value.
//
#ifdef COMPILE_REGRESSION_TEST
# define FILLMEIN 0
#else
# warning "You must replace the values marked FILLMEIN with real values from the TTN control panel!"
# define FILLMEIN (#dont edit this, edit the lines that use FILLMEIN)
#endif
// This EUI must be in little-endian format, so least-significant-byte
// first. When copying an EUI from ttnctl output, this means to reverse
// the bytes. For TTN issued EUIs the last bytes should be 0xD5, 0xB3,
// 0x70.
//static const u1_t PROGMEM APPEUI[8] = { 0x00, 0x00, 0x00, 0x00, 0x00, 0x00, 0x00, 0x70 };
//static const u1_t PROGMEM APPEUI[8] = { 0x11, 0x22, 0x33, 0x44, 0x55, 0x66, 0x77, 0x08 };
//static const u1_t PROGMEM APPEUI[8] = { 0x07, 0x77, 0x66, 0x55, 0x44, 0x33, 0x22, 0x11 };
static const u1_t PROGMEM APPEUI[8] = { 0x08, 0x77, 0x66, 0x55, 0x44, 0x33, 0x22, 0x11 };
void os_getArtEui(u1_t* buf) { memcpy_P(buf, APPEUI, 8); }

// This should also be in little-endian format, see above.
//static const u1_t PROGMEM DEVEUI[8] = { 0xD3, 0x92, 0x06, 0xD0, 0x7E, 0xD5, 0xB3, 0x70 };
//static const u1_t PROGMEM DEVEUI[8] = { 0x6A, 0x95, 0x06, 0xD0, 0x7E, 0xD5, 0xB3, 0x70 };
static const u1_t PROGMEM DEVEUI[8] = { 0x6A, 0x93, 0x06, 0xD0, 0x7E, 0xD5, 0xB3, 0x70 };
void os_getDevEui(u1_t* buf) { memcpy_P(buf, DEVEUI, 8); }

// This key should be in big endian format (or, since it is not really a
// number but a block of memory, endianness does not really apply). In
// practice, a key taken from ttnctl can be copied as-is.
//static const u1_t PROGMEM APPKEY[16] = { 0x11, 0x11, 0x22, 0x22, 0x33, 0x33, 0x44, 0x44, 0x55, 0x55, 0x66, 0x66, 0x77, 0x77, 0x11, 0x11 };
//static const u1_t PROGMEM APPKEY[16] = { 0x88, 0x88, 0x77, 0x77, 0x66, 0x66, 0x55, 0x55, 0x44, 0x44, 0x33, 0x33, 0x22, 0x22, 0x11, 0x11 };
static const u1_t PROGMEM APPKEY[16] = { 0x11, 0x11, 0x22, 0x22, 0x33, 0x33, 0x44, 0x44, 0x55, 0x55, 0x66, 0x66, 0x77, 0x77, 0x88, 0x88 };
void os_getDevKey(u1_t* buf) { memcpy_P(buf, APPKEY, 16); }

static uint8_t mydata[] = "\"device\":\"Aeronodo1\",\"temperatura\":\"88888\",\"humedad\":\"88888\",\"lux\":\"88888\",\"pH\":\"88888\"";
//static uint8_t mydata[] = "\"device\":\"Aeronodo1\",\"pH\":\"88888\"";
//static uint8_t mydata[] = "\"aaaaaa\":\"Aeronodo\",\"temperatura\":\"88888\",\"humedad\":\"88888\",\"lux\":\"88888\",\"pH\":\"88888\"";
static osjob_t sendjob;
const int maxSize = 100;
uint8_t msg_cast[maxSize];

// Schedule TX every this many seconds (might become longer due to duty
// cycle limitations).
const unsigned TX_INTERVAL = 1;

// CONTROL RELAY
const int led = 4;
// LMIC_radio pins
const lmic_pinmap lmic_pins = {
    .nss = 18,
    .rxtx = LMIC_UNUSED_PIN,
    .rst = 23,
    .dio = { /*dio0*/ 26, /*dio1*/ 33, /*dio2*/ 32 }
};
//************************************************************************************************************
// WATCHDOG TIMER --------------------------------------------------------------------------------------------
const int wdtTimeout = 50000;    //Watchdog timer timeout in ms
hw_timer_t *wdt_timer = NULL;
//************************************************************************************************************
// SENSORS FSM VARIABLES -------------------------------------------------------------------------------------
//*****************************************************
// ONLY MODIFY THE VARIABLES INSIDE THIS BOX
// NUMBER OF READING PER SAMPLE
const int c = 10; // Number or readings after compute an averaged sample

//DELAY TIME
const int delay_time = 2000;    // Delay time between each data measurment (ms)

// MISC
int count = 0;                  // FSM cycles counter
unsigned long int prev_time;    // Keep the previous registered time to compare during DELAY state
int loraflag = 1;               // Flag to excute LoRaWAN connection, it´s 0 when a message is upload to the network

// PH READING VARIABLES -------------------------------------------------
// This values were obtained by a calibration process with a set of buffered pH solutions
// CHANGE THEM ONLY IF NECCESSARY !!
  //5V
/*float acidVoltage = 2870;
float neutralVoltage = 2130;*/
  //3V3
float acidVoltage = 1980;
float neutralVoltage = 1560;
float ph_acid = 4.0;
float ph_neutral = 6.8;  
float ph_val;                   // pH reading varaible (pH)

// VARIABLES ------------------------------------------------------------
float ph_vec[c]; //Array for keep the readings before average them
float ph_mean = 0; //Resulting average for each measured variable

//************************************* MCCI LoRaWAN FUNCTIONS ***********************************************
//************************************************************************************************************

/*FN****************************************************************************
*
*   void printHex2(unsigned v)
*
*   Purpose: Print the value of v in hexadecimal format, padding single-digit 
*            values with a leading zero.
*
*   Parameters:
*       v: The unsigned integer value to be printed in hexadecimal format.
*
*   Plan: Mask the higher bits of v, check for single-digit values, and print 
*         the result in hexadecimal format.
*
*   Register of Revisions:
*
*   DATE         RESPONSIBLE     COMMENT
*   -----------------------------------------------------------------------
*   Sep 18/2017  T.Moore, MCCI   Initial implementation
*   Sep 11/2024  J.Rodríguez     Documentation
*
*******************************************************************************/
void printHex2(unsigned v) {
    v &= 0xff;
    if (v < 16)
        Serial.print('0');
    Serial.print(v, HEX);
}
/*FN****************************************************************************
*
*   void onEvent(ev_t ev)
*
*   Purpose: Handle different events related to LoRaWAN communication, such as 
*            joining, transmitting, and receiving data.
*
*   Parameters:
*       ev: The event type, which determines the action to be taken.
*
*   Plan: Use a switch statement to handle different events, printing 
*         descriptive messages to the serial console and performing 
*         necessary actions.
*
*   Register of Revisions:
*
*   DATE         RESPONSIBLE  COMMENT
*   -----------------------------------------------------------------------
*   Sep 18/2017  T.Moore, MCCI   Initial implementation
*   Sep 11/2024  J.Rodríguez     Documentation
*
*******************************************************************************/
void onEvent(ev_t ev) {
    Serial.print(os_getTime());
    Serial.print(": ");
    switch (ev) {
        case EV_SCAN_TIMEOUT:
            Serial.println(F("EV_SCAN_TIMEOUT"));
            break;
        case EV_BEACON_FOUND:
            Serial.println(F("EV_BEACON_FOUND"));
            break;
        case EV_BEACON_MISSED:
            Serial.println(F("EV_BEACON_MISSED"));
            break;
        case EV_BEACON_TRACKED:
            Serial.println(F("EV_BEACON_TRACKED"));
            break;
        case EV_JOINING:
            Serial.println(F("EV_JOINING"));
            break;
        case EV_JOINED:
        {   
            Serial.println("JOIN-------------------------------------");
            u4_t netid = 0;
            devaddr_t devaddr = 0;
            u1_t nwkKey[16];
            u1_t artKey[16];
            LMIC_getSessionKeys(&netid, &devaddr, nwkKey, artKey);
            Serial.print("netid: ");
            Serial.println(netid, DEC);
            Serial.print("devaddr: ");
            Serial.println(devaddr, HEX);
            Serial.print("AppSKey: ");
            for (size_t i = 0; i < sizeof(artKey); ++i) {
                if (i != 0)
                    Serial.print("-");
                printHex2(artKey[i]);
            }
            Serial.println("");
            Serial.print("NwkSKey: ");
            for (size_t i = 0; i < sizeof(nwkKey); ++i) {
                if (i != 0)
                    Serial.print("-");
                printHex2(nwkKey[i]);
            }
            Serial.println();
        }
        break;
        case EV_JOIN_FAILED:
            Serial.println(F("EV_JOIN_FAILED"));
            drawlorawan(0);
            break;
        case EV_REJOIN_FAILED:
            Serial.println(F("EV_REJOIN_FAILED"));
            drawlorawan(0);
            break;
        case EV_TXCOMPLETE:
            Serial.println("TXCOMPLETE-----------------------------------------");
            Serial.println(F("EV_TXCOMPLETE (includes waiting for RX windows)"));
            if (LMIC.txrxFlags & TXRX_ACK)
                Serial.println(F("Received ack"));
            if (LMIC.dataLen != 0) {
                // Datos recibidos. Extraer el número de puerto si lo hay.
                u1_t bPort = 0;
                if (LMIC.txrxFlags & TXRX_PORT)
                    bPort = LMIC.frame[LMIC.dataBeg - 1];
                // Llamar a la función proporcionada por el usuario con el puerto, el mensaje y la longitud del mensaje
                receiveMessage(bPort, LMIC.frame + LMIC.dataBeg, LMIC.dataLen);
            }
            // Programar la próxima transmisión
            //os_setCallback(&sendjob, do_send);
            drawlorawan(1);
            os_setTimedCallback(&sendjob, os_getTime() + sec2osticks(TX_INTERVAL), do_send);
            //os_clearCallback (&sendjob);
            break;
/*         case EV_RXCOMPLETE:
            Serial.println(F("EV_RXCOMPLETE"));
            if (LMIC.dataLen != 0) {
                // Datos recibidos
                u1_t bPort = 0;
                if (LMIC.txrxFlags & TXRX_PORT)
                    bPort = LMIC.frame[LMIC.dataBeg - 1];
                // Llamar a la función proporcionada por el usuario con el puerto, el mensaje y la longitud del mensaje
                receiveMessage(bPort, LMIC.frame + LMIC.dataBeg, LMIC.dataLen);
            }
            break; */
        case EV_LOST_TSYNC:
            Serial.println(F("EV_LOST_TSYNC"));
            break;
        case EV_RESET:
            Serial.println(F("EV_RESET"));
            break;
        case EV_LINK_DEAD:
            Serial.println(F("EV_LINK_DEAD"));
            break;
        case EV_LINK_ALIVE:
            Serial.println(F("EV_LINK_ALIVE"));
            break;
        case EV_TXSTART:
            Serial.println(F("EV_TXSTART"));
            break;
        case EV_TXCANCELED:
            Serial.println(F("EV_TXCANCELED"));
            break;
        case EV_RXSTART:
            break;
        case EV_JOIN_TXCOMPLETE:
            Serial.println(F("EV_JOIN_TXCOMPLETE: no JoinAccept"));
            break;
        default:
            Serial.print(F("Unknown event: "));
            Serial.println((unsigned)ev);
            break;
    }
}
/*FN****************************************************************************
*
*   void do_send(osjob_t* j)
*
*   Purpose: Prepare and send an upstream data transmission at the next possible time.
*
*   Parameters:
*       j: The OS job that triggered this function.
*
*   Plan: Check if there is no current TX/RX job running, prepare the data transmission,
*         and schedule the next transmission.
*
*   Register of Revisions:
*
*   DATE         RESPONSIBLE  COMMENT
*   -----------------------------------------------------------------------
*   Sep 18/2017  T.Moore, MCCI   Initial implementation
*   Sep 10/2024  J.Rodríguez     Alive message inclusion
*   Sep 11/2024  J.Rodríguez     Documentation
*
*******************************************************************************/
void do_send(osjob_t* j) {
    // Check if there is not a current TX/RX job running
    Serial.println("------DO SEND");
    if (LMIC.opmode & OP_TXRXPEND) {
        Serial.println(F("OP_TXRXPEND, not sending"));
    } else {
        // Prepare upstream data transmission at the next possible time.
        LMIC_setTxData2(1, mydata, sizeof(mydata)-1, 0);
        Serial.println(F("Packet queued"));
        LMIC_sendAlive();
        loraflag = 0;
        timerWrite(wdt_timer,0);
        Serial.println((char*)mydata);
    }
    // Next TX is scheduled after TX_COMPLETE event.
}

//************************************************************************************************************
//******************************************** DATA HANDLING *************************************************
//************************************************************************************************************

/*FN****************************************************************************
*
*   float data_validation(float data, int lw_lim, int up_lim)
*
*   Purpose: Validate read data is into the given range [lw_lim,up_lim].
*
*   Parameters:
*       data   : Input data to be validated
*       lw_lim : Lower limit for the data validation
*       up_lim : Upper limit for the data validation
*
*   Plan: Check if there is the data is not NaN or it´s outside of the 
*         range. Return an error code according if data is not validated
*
*   Register of Revisions:
*
*   DATE         RESPONSIBLE  COMMENT
*   -----------------------------------------------------------------------
*   Agu  3/2024  J.Rodríguez     Initial implementation
*   Sep 11/2024  J.Rodríguez     Documentation
*
*******************************************************************************/
float data_validation(float data, int lw_lim, int up_lim){
  if(!isnan(data)){
    if(data >= lw_lim){
      if(!(data <= up_lim)){
        Serial.println("DATA VALIDATION ERROR:Data out of upper limit");
        data = 803;
      }
    }else{
      Serial.println("DATA VALIDATION ERROR:Data out of lower limit");
      data = 802;
    }
  }else{
    Serial.println("DATA VALIDATION ERROR: NaN reading of variable ");
    data = 801;
  }

  return data;
}
/*FN****************************************************************************
*
*   float mean(float* vec, int size)
*
*   Purpose: Calculate the mean of an array of floats.
*
*   Parameters:
*       vec: The array of floats.
*       size: The size of the array.
*
*   Returns:
*       The calculated mean value.
*
*   Plan: Check if the array is not empty, then iterate over the array to calculate the sum,
*         and finally divide the sum by the size to get the mean.
*
*   Register of Revisions:
*
*   DATE         RESPONSIBLE  COMMENT
*   -----------------------------------------------------------------------
*   Sep 10/2024  J.Rodríguez  Initial Implementation
*   Sep 11/2024  J.Rodríguez  Documentation
*
*******************************************************************************/
float mean(float* vec, int size){
 if (size == 0) {
    Serial.println("mean: Empty array");
    return 0; 
  }

  float sum = 0;
  for (int i = 0; i < size; i++) {
    sum += vec[i];
  }

  float average = sum / size;
  return average;
}

//************************************************************************************************************

/*FN****************************************************************************
*
*   void drawbitmap(int flag)
*
*   Purpose: 
*       Draws a bitmap (logo) on the display, centered on the screen, 
*       based on the value of the 'flag' parameter.
*
*   Parameters:
*       flag: 
*           An integer that determines which logo to draw:
*           - 1: Draws the Agrosavia logo.
*           - 2: Draws the CEA logo.
*
*   Plan: 
*       - Clears the display screen.
*       - Depending on the value of 'flag', draws the corresponding 
*         bitmap at centered coordinates.
*       - Displays the bitmap on the screen and waits 1 second before 
*         allowing another action.
*
*   Register of Revisions:
*
*   DATE         RESPONSIBLE     COMMENT
*   -----------------------------------------------------------------------
*   Sep 21/2024  J.Rodriguez    Initial implementation of the function.
*   Sep 20/2024  J.Rodríguez    Documentation.
*
*******************************************************************************/
void drawbitmap(int flag) {
  display.clearDisplay();

  if (flag == 1){
    display.drawBitmap(
    (display.width()  - LOGO_WIDTH ) / 2,
    (display.height() - LOGO_HEIGHT) / 2,
    agrosavia_logo, LOGO_WIDTH, LOGO_HEIGHT, 1);
  } else if (flag == 2){
    display.drawBitmap(
    (display.width()  - LOGO_WIDTH ) / 2,
    (display.height() - LOGO_HEIGHT) / 2,
    cea_logo, LOGO_WIDTH, LOGO_HEIGHT, 1);
  }
  display.display();
  delay(2000);
  
}
/*FN****************************************************************************
*
*   void drawlorawan(bool state)
*
*   Purpose: 
*       Displays the current LoRaWAN connection status on the screen, showing 
*       either a "Connected" or "Unconnected" message along with an icon, based 
*       on the value of the 'state' parameter.
*
*   Parameters:
*       state: 
*           A boolean value that indicates the connection status:
*           - true: Shows "Connected" message and draws the connected icon.
*           - false: Shows "Unconnected" message and draws the unconnected icon.
*
*   Plan: 
*       - Clear the display screen to remove any previous content.
*       - Set up text size, color, and cursor position.
*       - Print the LoRaWAN status message based on the value of 'state'.
*       - Draw the appropriate icon (connected or unconnected) centered horizontally.
*       - Display the updated screen content.
*
*   Register of Revisions:
*
*   DATE         RESPONSIBLE     COMMENT
*   -----------------------------------------------------------------------
*   Oct 02/2024  J.Rodriguez    Initial implementation of the function.
*   Oct 03/2024  J.Rodríguez    Documentation.
*
*******************************************************************************/
void drawlorawan(bool state) {
  display.clearDisplay();

  display.setTextSize(1);
  display.setTextColor(SSD1306_WHITE);
  display.setCursor(0,0);
  display.println("");
  if (state == 1){
    display.print(F("LoRaWAN Status : \n"));
    display.println(F("Connected"));
    display.drawBitmap(
    (display.width()  - 30 ) / 2,
    30,
    connected_icon, 30, 30, 1);
  }
  else{
    display.print(F("LoRaWAN Status : \n"));
    display.println(F("Unconnected"));
    display.drawBitmap(
    (display.width()  - 30 ) / 2,
    30,
    unconnected_icon, 30, 30, 1);
  }
  display.display();
}
//************************************************************************************************************
//*********************************************** pH SENSOR **************************************************
//************************************************************************************************************

/*FN****************************************************************************
*
*   float PH_read(float ph_acid, float acid_voltage, float ph_neutral, float neutral_voltage)
*
*   Purpose: Read the voltage from the pH sensor, calculate the pH value 
*            using a linear calibration curve, and validate it.
*
*   Parameters:
*       ph_acid: The pH value for an acidic solution.
*       acid_voltage: The voltage value for an acidic solution.
*       ph_neutral: The pH value for a neutral solution.
*       neutral_voltage: The voltage value for a neutral solution.
*
*   Returns:
*       The calculated pH value.
*
*   Plan: Read voltage from pH sensor, calculate pH value using linear calibration 
*         curve, validate it, and return it.
*
*   Register of Revisions:
*
*   DATE         RESPONSIBLE  COMMENT
*   -----------------------------------------------------------------------
*   Sep 10/2024  J.Rodríguez  Initial Implementation
*   Sep 11/2024  J.Rodríguez  Documentation
*
*******************************************************************************/
float PH_read(float ph_acid,float acid_voltage, float ph_neutral, float neutral_voltage){
  static unsigned long timepoint = millis();
  float slope, intercept, ph_value, voltage;

  voltage = analogRead(PH_PIN)/4095.0*3300;
  slope = (ph_neutral - ph_acid)/((neutral_voltage-1500)/3.0 - (acid_voltage-1500)/3.0);
  intercept = ph_neutral - slope*(neutral_voltage-1500)/3.0;

  ph_value = slope*((voltage-1500)/3.0)+intercept;
  ph_value = data_validation(ph_value,0,14);

  Serial.print("pH = ");
  Serial.println(ph_value);

  return ph_value;
}

/*Falta por comentar esta*/

void receiveMessage(uint8_t bPort, uint8_t* message, uint8_t messageLength) {
    Serial.print("Received message on port ");
    Serial.println(bPort);
    Serial.print("Message: ");
    std::string receivedMessage = "";

    for (uint8_t i = 0; i < messageLength; i++) {
        Serial.print((char)message[i]);
        receivedMessage += (char)message[i];
    }
    Serial.println();

    if (receivedMessage == "1") {
        digitalWrite(led, HIGH);
        Serial.println("LED ON");
    } else if(receivedMessage == "0") {
        digitalWrite(led, LOW);
        Serial.println("LED OFF");
    }
}

//************************************************************************************************************
//****************************************** WATCHDOG TIMER **************************************************
//************************************************************************************************************

/*FN****************************************************************************
*
*   void resetModule()
*
*   Purpose: Reset the ESP32 module.
*
*   Plan: Print "reboot" to the console and restart the ESP32 module.
*
*   Register of Revisions:
*
*   DATE         RESPONSIBLE  COMMENT
*   -----------------------------------------------------------------------
*   Sep 10/2024  J.Rodríguez  Initial Implementation
*   Sep 11/2024  J.Rodríguez  Documentation
*
*******************************************************************************/
void ARDUINO_ISR_ATTR resetModule() {
  ets_printf("reboot\n");
  esp_restart();
}
//************************************************************************************************************
//********************************************* PRINCIPAL FSM ************************************************
//************************************************************************************************************


/*Falta por comentar esta*/
void FSM_control(hw_timer_t* wdt_timer){
  static control_states  c_st = INI;
  switch(c_st){
    case INI:
      timerWrite(wdt_timer,0);
      c_st = PH_READ;
    break;
    case PH_READ:
      ph_val = PH_read(ph_acid,acidVoltage,ph_neutral,neutralVoltage);
      c_st = KTD_1;
    break;
    case KTD_1:
      timerWrite(wdt_timer,0);
      count++;
      c_st = MEAN;
    break;
    case MEAN:
      Serial.print("Loop number # : ");
      Serial.println(count);
      if(count <= c){
        ph_vec[count-1] = ph_val;
        c_st = KTD_2;
      } else if (count >= c){
          ph_mean = mean(ph_vec,c-1); 
          count = 0;
          // Format the message to send using LoRaWAN
          //sprintf((char*)mydata,"\"device\":\"Aeronodo1\",\"pH\":\"%05.2f\"", ph_mean);
          sprintf((char*)mydata,"\"device\":\"Aeronodo1\",\"temperatura\":\"88888\",\"humedad\":\"88888\",\"lux\":\"88888\",\"pH\":\"%05.2f\"", ph_mean);
          c_st = SEND_DATA;
      }
    break;
    case SEND_DATA:
      Serial.println("SENDING_DATA");
      loraflag = 1;
      while(loraflag){
        os_runloop_once();
      }
      c_st = KTD_2;
    break;
    case KTD_2:
      timerWrite(wdt_timer,0);
      c_st = KTD_3;
    break;
    case KTD_3:
      timerWrite(wdt_timer,0);
      prev_time = millis();
      c_st = DELAY;
    break;
    case DELAY:
      if((prev_time - millis())< delay_time){
        c_st = DELAY;
      } else if ((millis() -prev_time) > delay_time){
        c_st = KTD_4;
      }
    break;
    case KTD_4:
      timerWrite(wdt_timer,0);
      c_st = PH_READ;
    break;
  }
}

void setup() {
  Serial.println(F("Starting"));
  //***********************************************************
    // SERIAL COMMS INITIALIZATION
    Serial.begin(115200);
    pinMode(led,OUTPUT);
  //***********************************************************
    // ESP32 WATCHDOG TIMER INITIALIZATION
    wdt_timer = timerBegin(1000000);                // 1MHz - Timer frecuency
    timerAttachInterrupt(wdt_timer, &resetModule);  // Attach interrump to timer
    timerAlarm(wdt_timer,wdtTimeout*1000,false,0);  // Alarm value configuration in microseconds (us)
  //***********************************************************
    // SDD1306 OLED SCREEN
   if(!display.begin(SSD1306_SWITCHCAPVCC, SCREEN_ADDRESS)) {
      Serial.println(F("SSD1306 allocation failed"));
      for(;;); // Don't proceed, loop forever
    }
    display.clearDisplay();
    drawbitmap(1);
    drawbitmap(2);
    display.clearDisplay();
    drawlorawan(1);
    delay(5000);
    drawlorawan(0);
    delay(5000);
  //***********************************************************
    // MCCI LoRaWAN LMIC INITIALIZATION 
    #ifdef VCC_ENABLE
    // For Pinoccio Scout boards
    pinMode(VCC_ENABLE, OUTPUT);
    digitalWrite(VCC_ENABLE, HIGH);
    delay(1000);
    #endif
    // LMIC init
    os_init();
    // Reset the MAC state. Session and pending data transfers will be discarded.
    LMIC_reset();
    // Disabling not select sub-bands
    for (int b = 0; b < 8; b++){
      LMIC_disableSubBand(b);
    }
    // Then enable the channel(s) you want to use
    LMIC_enableChannel(1); // 903.9 MHz
    LMIC_setClockError(MAX_CLOCK_ERROR * 10 / 100);
  //***********************************************************
   // Start job (sending automatically starts OTAA too)
    do_send(&sendjob); 
}

void loop() {
  FSM_control(wdt_timer);
}
